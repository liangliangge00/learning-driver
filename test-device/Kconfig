## test-device/Kconfig
```kconfig
source "drivers/test-device/hello/Kconfig"

source "drivers/test-device/i2c/Kconfig"

source "drivers/test-device/gpio/Kconfig"

source "drivers/test-device/gpio_ctrl/Kconfig"

source "drivers/test-device/input/Kconfig"

source "drivers/test-device/timer/Kconfig"

source "drivers/test-device/timer_list/Kconfig"
```

## test-device/gpio_ctrl/Kconfig
```kconfig
config GPIO_CTRL_TEST
	tristate "gpio_ctrl test device"
	help
		A simple driver for gpio_ctrl.
```

## test-device/input/Kconfig
```kconfig
config INPUT_TEST
	tristate "input test device"
	help
		A simple driver for input system.
```

## test-device/nfc/pn512/Kconfig
```kconfig
config PN512_NFC_TEST
	tristate "pn512 nfc test device"
	help
		A simple driver for pn512 nfc.
```

## test-device/timer/Kconfig
```kconfig
config TIMER_TEST
	tristate "input test device with timer"
	help
		A simple driver for input system.
```

## test-device/timer_list/Kconfig
```kconfig
config TIMER_LIST_TEST
	tristate "timer_list test"
	help
		A simple driver for struct timer_list.
```

## test-device/touchscreen/gsl1680/Kconfig
```kconfig
#
# GSL1680 touchscreen driver configuration
#

config TOUCHSCREEN_GSL1680
	bool "I2C"
	depends on I2C
	help
	  Say Y here if you have a GSL1680 touchscreen interfaced
	  to the host processor over I2C
	  If unsure, say N.
	  
```

## test-device/wiegand/Kconfig
```kconfig
config WIEGAND
	tristate "wiegand driver module"
	default n
	help
	Add support for the wiegand driver module
```
